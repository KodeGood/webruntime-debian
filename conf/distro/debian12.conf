## conf/distro/debian12.conf
```bitbake
require conf/distro/debian-bookworm.conf

DISTRO_APT_SOURCES += "conf/distro/debian12-backports.list"
DISTRO_APT_PREFERENCES += "conf/distro/preferences.debian12-backports.conf"
DISTRO_APT_PREFERENCES += "conf/distro/preferences.webruntime.conf"

PREFERRED_VERSION_libpng1.6 = "1.6.39"
```

## conf/distro/raspios-debian12.conf
```bitbake
BASE_DISTRO = "raspios64"

HOST_BASE_DISTRO = "debian"

BASE_DISTRO_CODENAME = "bookworm"
HOST_DISTRO = "debian-bookworm"
HOST_DISTRO_APT_SOURCES = "conf/distro/${HOST_DISTRO}.list"
HOST_DISTRO_APT_SOURCES += "conf/distro/debian12-backports.list"
HOST_DISTRO_APT_PREFERENCES += "conf/distro/preferences.debian12-backports.conf"

DISTRO_APT_SOURCES = "conf/distro/raspios-debian12.list"
DISTRO_APT_SOURCES += "conf/distro/debian12-backports.list"
DISTRO_APT_PREFERENCES += "conf/distro/preferences.debian12-backports.conf"

DISTRO_KERNELS = "rpi-v8 rpi-2712"

THIRD_PARTY_APT_KEYS += "http://archive.raspberrypi.org/debian/raspberrypi.gpg.key;sha256sum=76603890d82a492175caf17aba68dc73acb1189c9fd58ec0c19145dfa3866d56"

COMPAT_DISTRO_ARCH:arm64 = "armhf"

DISTRO_GCC = "12"
```

## conf/distro/raspios-debian13.conf
```bitbake
BASE_DISTRO = "raspios64"

HOST_BASE_DISTRO = "debian"

BASE_DISTRO_CODENAME = "trixie"
HOST_DISTRO = "debian-trixie"
HOST_DISTRO_APT_SOURCES = "conf/distro/${HOST_DISTRO}.list"

DISTRO_APT_SOURCES = "conf/distro/raspios-debian13.list"

DISTRO_KERNELS = "rpi-v8 rpi-2712"

THIRD_PARTY_APT_KEYS += "http://archive.raspberrypi.org/debian/raspberrypi.gpg.key;sha256sum=76603890d82a492175caf17aba68dc73acb1189c9fd58ec0c19145dfa3866d56"

COMPAT_DISTRO_ARCH:arm64 = "armhf"

DISTRO_GCC = "13"
```

## conf/layer.conf
```bitbake
BBPATH .= ":${LAYERDIR}"

BBFILES += "${LAYERDIR}/recipes-*/*/*.bb \
            ${LAYERDIR}/recipes-*/*/*.bbappend"

BBFILE_COLLECTIONS += "webruntime-debian"
BBFILE_PATTERN_webruntime-debian = "^${LAYERDIR}/"
BBFILE_PRIORITY_webruntime-debian = "6"

LAYERSERIES_COMPAT_webruntime-debian = "next"

LAYERDIR_webruntime-debian = "${LAYERDIR}"
```

## conf/machine/intel-nuc.conf
```bitbake
DISTRO_ARCH = "amd64"

KERNEL_NAME = "amd64"

IMAGE_FSTYPES ?= "wic"
WKS_FILE ?= "x86_64-generic.wks"
IMAGER_INSTALL:wic += "${GRUB_BOOTLOADER_INSTALL}"

IMAGE_INSTALL += "intel-nuc"
```

## conf/machine/rpi5.conf
```bitbake
DISTRO_ARCH = "arm64"
KERNEL_NAME = "rpi-2712"

BOOT_SPACE ?= "81920"
MACHINE_SERIAL ?= "serial0"
BAUDRATE_TTY ?= "115200"

IMAGE_FSTYPES ?= "wic"
WKS_FILE = "rpi5.wks"

# RPi have custom kernel file names
KERNEL_FILE = "${KERNEL_NAME}.img"

IMAGE_PREINSTALL += "raspi-firmware \
                     raspberrypi-sys-mods \
                     raspi-config \
                     systemd-sysv \
                     udev"

IMAGE_INSTALL += "rpi5"

IMAGER_INSTALL:wic += "parted \
                       dosfstools \
                       mtools \
                       e2fsprogs \
                       python3-setuptools \
                       bmap-tools"

IMAGE_BOOT_FILES ?= "${IMAGE_ROOTFS}/boot/firmware/*.*;./ \
                     ${IMAGE_ROOTFS}/boot/firmware/overlays/*;overlays/"
```

## wic/x86_64-generic.wks
```
part /boot --source bootimg-efi-isar --sourceparams "loader=grub-efi" --label efi --part-type EF00 --align 1024

part / --source rootfs --fstype ext4 --mkfs-extraopts "-T default" --label platform --align 1024 --use-uuid

bootloader --ptable gpt --timeout 0 --append "rw rootwait quiet splash consoleblank=0 loglevel=3 rd.systemd.show_status=auto rd.udev.log-priority=3 vt.global_cursor_default=0"
```
